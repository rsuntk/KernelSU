## kernel/Kconfig
```kconfig
menu "KernelSU"

config KSU
	bool "KernelSU function support"
	depends on !CPU_BIG_ENDIAN
	depends on SECURITY_SELINUX
	select SECCOMP
	default y
	help
	  Enable kernel-level root privileges on Android System.

config KSU_EXTRAS
	bool "Enable custom stuff"
	depends on KSU
	default n
	help
	  Custom extensions. Experimental.
	  Currently, only avc log spoofing is implemented.

config KSU_KPROBES_KSUD
	bool "Enable dynamic kprobes for early boot hooks"
	depends on KPROBES && KRETPROBES
	default y
	help
	  Use dynamic hooks via kprobes for functions only
	  on early boot. Hooks are unregistered at boot complete
	  to reduce overhead.

config KSU_TAMPER_SYSCALL_TABLE
	bool "EXPERIMENTAL: tamper sys_call_table for sucompat + sys_reboot"
	depends on (ARM || ARM64) && !CFI_CLANG && !CFI
	default n
	help
	  EXPERIMENTAL: use syscall table hijacking method demonstrated on zx2c4's
	  kernel-assisted-superuser. Replaces sys_reboot, sys_execve, sys_newfstatat,
	  sys_faccessat, sys_newfstat_ret manual hooks.
	  Personally tested on Linux 3.10 ~ 4.14, aarch64.

config KSU_FEATURE_SULOG
	bool "KernelSU SU Logging feature"
	depends on KSU
	default y
	help
	  Build KernelSU's SU Log.

config KSU_FEATURE_ADBROOT
	bool "KernelSU ADB Root feature"
	depends on KSU
	default y
	help
	  Build KernelSU's adb root feature.

config KSU_DEBUG
	bool "KernelSU debug mode"
	depends on KSU
	default n
	help
	  Enable KernelSU debug mode.

config KSU_LSM_SECURITY_HOOKS
	bool "Use LSM security hooks"
        depends on KSU
        default y
	help
	  Disabling this is mostly useful for kernel > 6.8.
	  Make sure to implement manual hooks on security/security.c.

endmenu
```
